## sdkconfig.defaults
```kconfig
CONFIG_COMPILER_CXX_EXCEPTIONS=y
CONFIG_COMPILER_CXX_EXCEPTIONS_EMG_POOL_SIZE=1024
CONFIG_COMPILER_CXX_RTTI=y
CONFIG_COMPILER_OPTIMIZATION_PERF=y

CONFIG_SPIRAM=y
CONFIG_SPIRAM_MODE_OCT=y
CONFIG_SPIRAM_SPEED_80M=y
CONFIG_SPIRAM_MEMTEST=n
CONFIG_SPIRAM_MALLOC_RESERVE_INTERNAL=65536

CONFIG_ESPTOOLPY_FLASHSIZE_16MB=y
CONFIG_ESPTOOLPY_FLASHMODE_QIO=y
CONFIG_BOOTLOADER_LOG_LEVEL_NONE=y
CONFIG_BOOTLOADER_SKIP_VALIDATE_ALWAYS=y
CONFIG_BOOTLOADER_COMPILER_OPTIMIZATION_PERF=y
CONFIG_BOOTLOADER_APP_ROLLBACK_ENABLE=y

CONFIG_ESP_DEFAULT_CPU_FREQ_MHZ_240=y
CONFIG_ESP_SYSTEM_EVENT_TASK_STACK_SIZE=4096
CONFIG_ESP_MAIN_TASK_STACK_SIZE=4096
CONFIG_ESP_MAIN_TASK_AFFINITY_CPU1=y
CONFIG_FREERTOS_GENERATE_RUN_TIME_STATS=y

CONFIG_UHCI_ISR_CACHE_SAFE=y
CONFIG_UART_ISR_IN_IRAM=y
CONFIG_GPIO_CTRL_FUNC_IN_IRAM=y
CONFIG_PM_ENABLE=y
CONFIG_FREERTOS_USE_TICKLESS_IDLE=y
CONFIG_FREERTOS_HZ=1000

CONFIG_LWIP_DHCP_COARSE_TIMER_SECS=60
CONFIG_LWIP_TCP_TMR_INTERVAL=500
# TCP timer 粒度 = 2×TMR；RTO tick = RTO_TIME / (2×TMR)。
# 最终选定：2×500=1000ms 粒度，RTO=2000/1000=2 ticks=2s。
# 移动 TDD（RTT ~282ms）上 1s 也会触发大量重传，2s 两边都稳。
CONFIG_LWIP_TCP_RTO_TIME=2000
# 下行吞吐：接收窗口拉到无窗口缩放时的上限 65535，接收邮箱按 ESP-IDF 推荐公式
# LWIP_TCP_WND_DEFAULT/TCP_MSS + 2 = 65535/1440 + 2 = 47
CONFIG_LWIP_TCP_WND_DEFAULT=65535
CONFIG_LWIP_TCP_RECVMBOX_SIZE=47
# 上行：发送缓冲。实测 32768 反而掉到 305-313 KB/s（在途数据被 BDP 卡住），
# 65535 是当前最优（392-466 KB/s）；pcap 里 7% 的突发丢包是 4G 上行固有，
# 缩小窗口只减 BDP、压不住丢包。
CONFIG_LWIP_TCP_SND_BUF_DEFAULT=65535

# 下载方向的流控：让 esp_netif_receive() 把 lwIP 收包失败的真实错误返回给驱动
# （默认关闭时恒返回 ESP_OK）。spi_eth_modem 用它判断 RX 拥塞并给从机发 XOFF。
CONFIG_ESP_NETIF_RECEIVE_REPORT_ERRORS=y

CONFIG_ESP_CONSOLE_USB_SERIAL_JTAG=y
CONFIG_ESP_CONSOLE_SECONDARY_NONE=y

CONFIG_LV_BUILD_EXAMPLES=n
CONFIG_LV_BUILD_DEMOS=n

CONFIG_LV_OS_NONE=y
CONFIG_LV_USE_CLIB_MALLOC=y
CONFIG_LV_USE_CLIB_STRING=y
CONFIG_LV_USE_CLIB_SPRINTF=y
CONFIG_LV_USE_IMGFONT=y
CONFIG_LV_USE_ASSERT_STYLE=y
CONFIG_LV_USE_LODEPNG=y

# Use compressed font
CONFIG_LV_FONT_FMT_TXT_LARGE=y
CONFIG_LV_USE_FONT_COMPRESSED=n
CONFIG_LV_USE_FONT_PLACEHOLDER=n

# mbedTLS configuration for QUIC/HTTP3
CONFIG_MBEDTLS_HKDF_C=y
CONFIG_MBEDTLS_SSL_PROTO_TLS1_3=y
CONFIG_MBEDTLS_ECDH_C=y
CONFIG_MBEDTLS_ECDSA_C=y
CONFIG_MBEDTLS_ECP_C=y
CONFIG_MBEDTLS_ECP_DP_CURVE25519_ENABLED=y
CONFIG_MBEDTLS_KEY_EXCHANGE_ECDHE_ECDSA=y
CONFIG_MBEDTLS_KEY_EXCHANGE_ECDHE_RSA=y

CONFIG_PARTITION_TABLE_CUSTOM_FILENAME="partitions.csv"
```
